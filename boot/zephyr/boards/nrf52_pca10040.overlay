&spi2 {
    compatible = "nordic,nrf-spim";
    sdhc0: sdhc@0 {
        compatible = "zephyr,mmc-spi-slot";
        reg = <0>;
        status = "okay";
        label = "SDHC0";
        spi-max-frequency = <8000000>;
    };
};
