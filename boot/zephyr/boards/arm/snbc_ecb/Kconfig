## boot/zephyr/boards/arm/snbc_ecb/Kconfig.board
```kconfig
# SNBC_ECB board configuration

config BOARD_SNBC_ECB
	bool "Locker SNBC ECB board"
	depends on SOC_NRF52832_QFAA
```

## boot/zephyr/boards/arm/snbc_ecb/Kconfig.defconfig
```kconfig
# SNBC ECB board configuration

if BOARD_SNBC_ECB

config BOARD
	default "snbc_ecb"

config BT_CTLR
	default BT

endif # BOARD_SNBC_ECB
```

## boot/zephyr/boards/arm/snbc_ecb/snbc_ecb_defconfig
```kconfig
#############################################################################
# Base board configuration
#############################################################################

CONFIG_SOC_SERIES_NRF52X=y
CONFIG_SOC_NRF52832_QFAA=y
CONFIG_BOARD_SNBC_ECB=y

# fixed board settings
# CONFIG_SOC_DCDC_NRF52X=n
# CONFIG_GPIO_AS_PINRESET=n

# Enable MPU
CONFIG_ARM_MPU=y

# enable GPIO
CONFIG_GPIO=y

#############################################################################
# UART configuration
#############################################################################

#CONFIG_SERIAL=y
#CONFIG_UART_ASYNC_API=y
#CONFIG_NRFX_UARTE=y
#CONFIG_NRFX_UARTE0=y

#CONFIG_UART_0_NRF_UART=y
#CONFIG_UART_0_NRF_UARTE=y
#CONFIG_UART_0_ASYNC=y
#CONFIG_UART_0_NRF_TX_BUFFER_SIZE=32

#############################################################################
# SD card & filesystem configuration
#############################################################################

CONFIG_SPI=y
CONFIG_SPI_2=y

# To investigate SPIM driver use
# CONFIG_NRF52832_SPIM_PAN58_WORKAROUND=y
# CONFIG_SPI_2_NRF_SPIM=y
# CONFIG_SPI_NRFX_RAM_BUFFER_SIZE=8
# CONFIG_SPI_LOG_LEVEL_DBG=y
# CONFIG_DISK_LOG_LEVEL_DBG=y
# CONFIG_NRFX_GPIOTE=y
# CONFIG_NRFX_PPI=y

CONFIG_DISK_ACCESS=y
CONFIG_DISK_ACCESS_SDHC=y
CONFIG_DISK_ACCESS_SPI_SDHC=y
CONFIG_FILE_SYSTEM=y
CONFIG_FAT_FILESYSTEM_ELM=y

#############################################################################
# Bluetooth configuration
#############################################################################

#CONFIG_BT=y
#CONFIG_BT_DEVICE_NAME="Zetbox"
#CONFIG_BT_DEVICE_NAME_DYNAMIC=n
#CONFIG_BT_DEVICE_APPEARANCE=0
#CONFIG_BT_PRIVACY=y
#CONFIG_BT_ATT_PREPARE_COUNT=5
#CONFIG_BT_PERIPHERAL=y
#CONFIG_BT_SMP=y
#CONFIG_BT_SIGNING=y

#CONFIG_BT_CTLR=y
#CONFIG_BT_LL_SW_SPLIT=y
#CONFIG_BT_CTLR_CRYPTO=y
#CONFIG_BT_CTLR_LE_ENC=y
#CONFIG_BT_CTLR_PRIVACY=y
#CONFIG_BT_CTLR_FILTER=y
#CONFIG_BT_CTLR_TX_BUFFER_SIZE=251
#CONFIG_BT_CTLR_DATA_LENGTH_MAX=251

#CONFIG_BT_GATT_DIS=y
#CONFIG_BT_GATT_DIS_MANUF="Packeta"
#CONFIG_BT_GATT_DIS_MODEL="ZB01"

#############################################################################
# JLink RTT configuration
#############################################################################

CONFIG_USE_SEGGER_RTT=y
CONFIG_SEGGER_RTT_MAX_NUM_UP_BUFFERS=1
CONFIG_SEGGER_RTT_MAX_NUM_DOWN_BUFFERS=1
CONFIG_SEGGER_RTT_BUFFER_SIZE_UP=4096
CONFIG_SEGGER_RTT_PRINTF_BUFFER_SIZE=128

#############################################################################
# Console subsystem
#############################################################################

CONFIG_CONSOLE=y
CONFIG_UART_CONSOLE=n
CONFIG_RTT_CONSOLE=y

#############################################################################
# Logging subsystem
#############################################################################

CONFIG_LOG=y
#CONFIG_LOG_RUNTIME_FILTERING=n
CONFIG_LOG_BUFFER_SIZE=16384
#CONFIG_LOG_PROCESS_THREAD=y
#CONFIG_LOG_PROCESS_TRIGGER_THRESHOLD=1
#CONFIG_LOG_PROCESS_THREAD_SLEEP_MS=100
#CONFIG_LOG_PROCESS_THREAD_STACK_SIZE=4096
CONFIG_LOG_DEFAULT_LEVEL=4
CONFIG_LOG_PRINTK=y
CONFIG_LOG_PRINTK_MAX_STRING_LENGTH=128
CONFIG_LOG_BACKEND_UART=n
CONFIG_LOG_BACKEND_RTT=y
CONFIG_LOG_BACKEND_RTT_BUFFER=0
CONFIG_LOG_STRDUP_BUF_COUNT=16
```
